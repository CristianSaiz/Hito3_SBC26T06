## main/Kconfig.projbuild
```kconfig
menu "Configuracion Wi-Fi SBC"
    config AP_WIFI_PASSWORD
        string "Contraseña del SoftAP de rescate"
        default "12345678"
        help
            Contraseña WPA2 para la red de recuperación. Minimo 8 caracteres.
endmenu
```

## sdkconfig.defaults
```kconfig
CONFIG_PARTITION_TABLE_CUSTOM=y
CONFIG_PARTITION_TABLE_CUSTOM_FILENAME="partitions.csv"
CONFIG_ESPTOOLPY_FLASHSIZE_4MB=y
CONFIG_BT_ENABLED=y
CONFIG_BT_NIMBLE_ENABLED=y
CONFIG_HTTPD_MAX_REQ_HDR_LEN=2048
CONFIG_HTTPD_MAX_URI_LEN=1024
```
